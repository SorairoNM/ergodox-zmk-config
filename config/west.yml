## config/west.yml
```yaml
manifest:
  remotes:
    - name: SorairoNM
      url-base: https://github.com/SorairoNM
  projects:
    - name: sorairo-zmk
      remote: SorairoNM
      revision: v20240114-min
      import: app/west.yml
  self:
    path: config
```
